## drivers/gpu/arm/midgard/platform/sharkl5Pro/Kconfig
```kconfig
#
# Kconfig for Unisoc sharkl5Pro platform
#

config MALI_PLATFORM_SHARKL5PRO
	bool "ARM Mali Midgard support for Unisoc sharkl5Pro"
	depends on MALI_MIDGARD
	default y
	help
	  Enables platform-specific clock, power management, and board configuration
	  for the Unisoc sharkl5Pro SoC with ARM Mali Midgard GPU.
```
