i2c@70600000 {
    #address-cells = <0x01>;
    #size-cells = <0x00>;
    compatible = "sprd,sharkl5pro-i2c";
    reg = <0x00 0x70600000 0x00 0x100>;
    clock-names = "enable", "i2c", "source";
    clocks = <0x1c 0x0c 0x1d 0x08 0x1e>;
    clock-frequency = <400000>; /* 0x61a80 (400 kHz Fast-Mode) */
    interrupts = <0x00 0x0e 0x04>;
    status = "okay";

    #include "touchscreen/himax_touch.dtsi"
    #include "touchscreen/goodix_touch.dtsi"
    #include "touchscreen/synaptics_touchscreen.dtsi"
    #include "touchscreen/novatek_touch.dtsi"
    #include "touchscreen/silead_touch.dtsi"
    #include "touchscreen/solomon_touchscreen.dtsi"
    #include "touchscreen/focaltech_touch.dtsi"
};
